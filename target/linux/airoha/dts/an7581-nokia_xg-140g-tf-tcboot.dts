// SPDX-License-Identifier: GPL-2.0-only OR MIT

#include "an7581-nokia_xg-040g-md-common.dtsi"
#include "an758x-nokia_xg-040g-tcboot-parts.dtsi"

/ {
	model = "Nokia XG-140G-TF (tcboot)";
	compatible = "nokia,xg-140g-tf-tcboot", "airoha,an7581",
		     "airoha,en7581";

	leds {
		/delete-node/ led-4;
		/delete-node/ led-5;
	};

	/delete-node/ regulator-usb-5v;
	/delete-node/ usb-power;
};

&usb0 {
	status = "disabled";
	/delete-property/ vusb33-supply;
	/delete-property/ #address-cells;
	/delete-property/ #size-cells;
	/delete-node/ port@1;
};

&usb1 {
	status = "disabled";
	/delete-property/ vusb33-supply;
	/delete-property/ #address-cells;
	/delete-property/ #size-cells;
	/delete-node/ port@1;
};
